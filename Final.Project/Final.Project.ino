#include <Adafruit_CircuitPlayground.h>

#define DICE_COLOR          0xEA6292    // Dice digits color

int scoreA = 0;
int scoreB = 0;
int winningScore = 10;
bool isPlayerATurn = 1;
volatile bool rolling = 0;
volatile bool newRoll = 0;
volatile bool skipTurn = 0;
uint8_t rollNumber;

/*used the pixel pattern array down below and some of the bools up above from the dice code.
https://learn.adafruit.com/circuit-playground-d6-dice/d6-dice-code*/

uint8_t dicePixels[6][6] = 
{  // Pixel pattern for dice roll
  { 2, 0, 0, 0, 0, 0 } ,      // Roll = 1
  { 4, 9, 0, 0, 0, 0 } ,      //        2
  { 0, 4, 7, 0, 0, 0 } ,      //        3
  { 1, 3, 6, 8, 0, 0 } ,      //        4
  { 0, 2, 4, 5, 9, 0 } ,      //        5
  { 0, 2, 4, 5, 7, 9 } ,      //        6
};

//integers for speaker numbers and player win/skipping turns
const uint8_t spONE[]           PROGMEM = {0x66,0x4E,0xA8,0x7A,0x8D,0xED,0xC4,0xB5,0xCD,0x89,0xD4,0xBC,0xA2,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0xFE,0x1F};
const uint8_t spTWO[]           PROGMEM = {0x06,0xB8,0x59,0x34,0x00,0x27,0xD6,0x38,0x60,0x58,0xD3,0x91,0x55,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0xFF,0x1F};
const uint8_t spTHREE[]         PROGMEM = {0x0C,0xE8,0x2E,0x94,0x01,0x4D,0xBA,0x4A,0x40,0x03,0x16,0x68,0x69,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0xFF,0x03};
const uint8_t spFOUR[]          PROGMEM = {0x08,0x68,0x21,0x0D,0x03,0x04,0x28,0xCE,0x92,0x03,0x23,0x4A,0xCA,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0xF2,0xFF};
const uint8_t spFIVE[]          PROGMEM = {0x08,0x68,0x4E,0x9D,0x02,0x1C,0x60,0xC0,0x8C,0x69,0x12,0xB0,0xC0,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0xFF,0x01};
const uint8_t spSIX[]           PROGMEM = {0x04,0xF8,0xAD,0x4C,0x02,0x16,0xB0,0x80,0x06,0x56,0x35,0x5D,0xA8,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0xFF,0x01};
const uint8_t spPASS[]          PROGMEM = {0x0A,0xC8,0x33,0x83,0x03,0xA3,0xEC,0x55,0x2D,0xD4,0x12,0xAF,0xAA,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0xFF,0x03};
const uint8_t spBRAVO[]         PROGMEM = {0x61,0x5A,0xBA,0xC2,0xDD,0x62,0x85,0xD6,0xE8,0x15,0x59,0xB1,0x97,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0xF3,0xFF};


void setup() {
  Serial.begin(9600);
  CircuitPlayground.begin();
  CircuitPlayground.setBrightness(100);

  // Setup button interrupts and callback functions
  attachInterrupt(digitalPinToInterrupt(4), buttonAPressed, FALLING);
  attachInterrupt(digitalPinToInterrupt(5), skipTurnButton, FALLING);

  // Seed the random function with light sensor value
  randomSeed(CircuitPlayground.lightSensor());
}


void loop() {
  //code for skipping turns
  if (skipTurn){
    isPlayerATurn = !isPlayerATurn;
    skipTurn = 0;
    CircuitPlayground.clearPixels();
    delay(1000);
  }

  // Check if a new roll is requested
  if (newRoll) {
    spinAnimation(); // Play the spinning animation and tone
    rollNumber = random(1, 7);  // Compute a random number from 1 to 6
    CircuitPlayground.clearPixels(); // Display the dice roll number
    for (int p = 0; p < rollNumber; p++) 
    {
      CircuitPlayground.setPixelColor(dicePixels[rollNumber - 1][p], DICE_COLOR);
    }

    speakNumber(rollNumber); // Speak the number rolled
    applyRules(); //applyrules

    //check for winning condition
    if (scoreA == winningScore || scoreB == winningScore){
      if (scoreA == winningScore){
        Serial.println("PLAYER A WINS!");
        for (int i = 0; i < 10; i++) {
      CircuitPlayground.setPixelColor(i, 0, 255, 0);  // Green color (R, G, B)
      }
        delay(50);
        CircuitPlayground.speaker.say(spBRAVO);
      }
      else {
        Serial.println("PLAYER B WINS!");
        for (int i = 0; i < 10; i++) {
      CircuitPlayground.setPixelColor(i, 0, 255, 0);  // Green color (R, G, B)
      }
        delay(50);
        CircuitPlayground.speaker.say(spBRAVO);
      }

    // Reset the scores and game state
      scoreA = 0;
      scoreB = 0;
      isPlayerATurn = 1;
  }

    // Reset the score if a player goes over the target number
    if (scoreA > winningScore) {
      scoreA = 0;
    }
    if (scoreB > winningScore) {
      scoreB = 0;
    }

 // Print the current scores of both players after resetting
  Serial.print(" Player A score: ");
  Serial.print(scoreA);
  Serial.print(" Player B score: ");
  Serial.print(scoreB);
  Serial.println();

  // Delay for a short period to show the result
  delay(2000);

  // Reset the roll state
    CircuitPlayground.clearPixels();
    newRoll = false;
    rolling = false;
    isPlayerATurn = !isPlayerATurn;
  }
}

//code for skipping a turn. The pixels turn red and the speaker says pass.
void skipTurnButton()
{
  skipTurn = 1;
  for (int i = 0; i < 10; i++) {
  CircuitPlayground.setPixelColor(i, 255, 0, 0);  // red color (R, G, B)
  }
  CircuitPlayground.speaker.say(spPASS);
}

//if button A is pressed, set integers to true
void buttonAPressed() {
  if (!rolling) {
    newRoll = 1;
    rolling = 1;
  }
}

//rules for the dice numbers and their affect on the score
void applyRules()
{
 //rule: rolling a 1, 4, or 5 gives you that roll plus an extra point
 if (rollNumber==1 || rollNumber==4 || rollNumber == 5){
   if (isPlayerATurn){
     scoreA += (rollNumber + 1);
   } else {
     scoreB += (rollNumber + 1);
   }
   return;
 }

//rule: rolling a 2 or 3 just adds that number to score
if (rollNumber == 2 || rollNumber == 3){
  if (isPlayerATurn){
    scoreA += rollNumber;
  } else {
    scoreB += rollNumber;
  }
  return;
}
 //rule: rolling a 6 makes you lose a point
 if (rollNumber==6){
   if (isPlayerATurn){
     scoreA--;
   }else{
     scoreB--;
   }
   return;
 }
}

//code for the animation before a dice roll
void spinAnimation() {
  int numSteps = 10;

  for (int i = 0; i < numSteps; i++) {
    CircuitPlayground.clearPixels();
    CircuitPlayground.setPixelColor(i, DICE_COLOR);
    CircuitPlayground.speaker.set(200);
    CircuitPlayground.playTone(i * 200 + 200, 50);
    delay(50);
  }

  for (int i = numSteps - 2; i >= 1; i--) {
    CircuitPlayground.clearPixels();
    CircuitPlayground.setPixelColor(i, DICE_COLOR);
    delay(50);
  }
}

//switch cases for speaking the different dice rolls
void speakNumber(uint8_t number) {
  CircuitPlayground.speaker.set(255);
switch (number) {
    case 1:
      CircuitPlayground.speaker.say(spONE);
      break;
    case 2:
      CircuitPlayground.speaker.say(spTWO);
      break;
    case 3:
      CircuitPlayground.speaker.say(spTHREE);
      break;
    case 4:
      CircuitPlayground.speaker.say(spFOUR);
      break;
    case 5:
      CircuitPlayground.speaker.say(spFIVE);
      break;
    case 6:
      CircuitPlayground.speaker.say(spSIX);
      break;
    default:
      return;
  }
}
